/**
  ******************************************************************************
  * @file           : oled.c
  * @brief          : SSD1306 OLED 128x64 I2C Driver
  *
  * I2C1: PB6=SCL  PB7=SDA   Address: 0x3C (7-bit)
  * Resolution: 128x64,  Page addressing mode
  ******************************************************************************
  */

#include "oled.h"
#include "i2c_scanner.h"
#include "chinese_font.h"
#include <string.h>
#include <stdio.h>

#define OLED_ADDR       0x78    /* 0x3C << 1 (8-bit write address) */
#define OLED_CMD        0x00    /* 命令前缀: Co=0, D/C#=0 */
#define OLED_DATA       0x40    /* 数据前缀: Co=0, D/C#=1 */

/* ── 帧缓冲区: 128 x 64 pixels = 128 x 8 pages ──────────────── */
static uint8_t oled_buffer[128][8];

/* ── 6x8 ASCII 字库 (0x20~0x7E, 95 个字符) ────────────────── */
static const uint8_t font6x8[][6] = {
    {0x00,0x00,0x00,0x00,0x00,0x00}, /*    */
    {0x00,0x00,0x5F,0x00,0x00,0x00}, /* !  */
    {0x00,0x07,0x00,0x07,0x00,0x00}, /* "  */
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    {0x08,0x04,0x08,0x10,0x08,0x00}, /* ~  */
};

/* ── I2C 底层操作 ──────────────────────────────────────────── */
static void oled_write_cmd(uint8_t cmd)
{
    uint8_t buf[2] = {OLED_CMD, cmd};
    HAL_I2C_Master_Transmit(&hi2c1, OLED_ADDR, buf, 2, 100);
}

/* ── SSD1306 初始化序列 ────────────────────────────────────── */
void oled_init(void)
{
    /* 切换 I2C 到 400kHz (OLED 刷新更快) */
    hi2c1.Init.ClockSpeed  = 400000;
    hi2c1.Init.DutyCycle   = I2C_DUTYCYCLE_16_9;
    HAL_I2C_Init(&hi2c1);

    HAL_Delay(50);

    oled_write_cmd(0xAE);      /* display off */
    oled_write_cmd(0x20);      /* set memory addressing mode */
    oled_write_cmd(0x00);      /* horizontal addressing mode */
    oled_write_cmd(0xB0);      /* set page start address 0-7 */
    oled_write_cmd(0xC8);      /* COM scan from COM[N-1] to COM0 */
    oled_write_cmd(0x00);      /* set low column address */
    oled_write_cmd(0x10);      /* set high column address */
    oled_write_cmd(0x40);      /* set display start line */
    oled_write_cmd(0x81);      /* set contrast */
    oled_write_cmd(0xFF);      /* contrast max */
    oled_write_cmd(0xA1);      /* segment re-map, column 127 = SEG0 */
    oled_write_cmd(0xA6);      /* normal display (not inverse) */
    oled_write_cmd(0xA8);      /* set multiplex ratio */
    oled_write_cmd(0x3F);      /* 64 lines */
    oled_write_cmd(0xA4);      /* output follows RAM content */
    oled_write_cmd(0xD3);      /* set display offset */
    oled_write_cmd(0x00);      /* no offset */
    oled_write_cmd(0xD5);      /* set display clock divide / oscillator */
    oled_write_cmd(0xF0);      /* max frequency */
    oled_write_cmd(0xD9);      /* set pre-charge period */
    oled_write_cmd(0x22);      /* phase1=2, phase2=2 */
    oled_write_cmd(0xDA);      /* set COM pins */
    oled_write_cmd(0x12);      /* alternative COM pin config */
    oled_write_cmd(0xDB);      /* set VCOMH deselect level */
    oled_write_cmd(0x20);      /* ~0.77 x VCC */
    oled_write_cmd(0x8D);      /* charge pump */
    oled_write_cmd(0x14);      /* enable */
    oled_write_cmd(0xAF);      /* display ON */

    oled_clear();
    oled_show();
}

/* ── 清屏 ──────────────────────────────────────────────────── */
void oled_clear(void)
{
    memset(oled_buffer, 0x00, sizeof(oled_buffer));
}

/* ── 全屏刷新 (批量I2C发送, 每页一次传输) ────────────────── */
void oled_show(void)
{
    uint8_t page, col;
    for (page = 0; page < 8; page++)
    {
        oled_write_cmd(0xB0 + page);
        oled_write_cmd(0x00);
        oled_write_cmd(0x10);

        /* 构建 129 字节缓冲: [0x40] + [128 bytes pixel data] */
        uint8_t buf[129];
        buf[0] = OLED_DATA;
        for (col = 0; col < 128; col++)
            buf[col + 1] = oled_buffer[col][page];

        HAL_I2C_Master_Transmit(&hi2c1, OLED_ADDR, buf, 129, 100);
    }
}

/* ── 设置光标 ──────────────────────────────────────────────── */
void oled_set_pos(uint8_t x, uint8_t y)
{
    /* 仅用于 oled_show_char 手动定位 (page mode) */
    oled_write_cmd(0xB0 + y);
    oled_write_cmd(((x & 0xF0) >> 4) | 0x10);   /* 高4位 */
    oled_write_cmd(x & 0x0F);                     /* 低4位 */
}

/* ── 画点 (1=亮, 0=灭) ─────────────────────────────────────── */
void oled_draw_point(uint8_t x, uint8_t y, uint8_t mode)
{
    if (x >= 128 || y >= 64) return;
    if (mode)
        oled_buffer[x][y / 8] |=  (1 << (y % 8));
    else
        oled_buffer[x][y / 8] &= ~(1 << (y % 8));
}

/* ── 读点 (调试用) ─────────────────────────────────────────── */
uint8_t oled_get_pixel(uint8_t x, uint8_t y)
{
    if (x >= 128 || y >= 64) return 0;
    return (oled_buffer[x][y / 8] >> (y % 8)) & 1;
}

/* ── 显示 6x8 字符 (写入帧缓冲) ───────────────────────────── */
void oled_show_char(uint8_t x, uint8_t y, char ch)
{
    uint8_t i;
    uint8_t idx;

    if (ch < ' ' || ch > '~') ch = ' ';     /* 不可打印 → 空格 */
    idx = (uint8_t)(ch - ' ');

    for (i = 0; i < 6; i++)
    {
        if (x + i >= 128) break;
        oled_buffer[x + i][y] = font6x8[idx][i];
    }
}

/* ── 显示字符串 ────────────────────────────────────────────── */
void oled_show_string(uint8_t x, uint8_t y, const char *str)
{
    while (*str)
    {
        oled_show_char(x, y, *str);
        x += 6;
        if (x > 122)
        {
            x = 0;
            y++;
            if (y > 7) break;
        }
        str++;
    }
}

/* ── 显示数字 ──────────────────────────────────────────────── */
void oled_show_num(uint8_t x, uint8_t y, int num, uint8_t len)
{
    char buf[12];
    snprintf(buf, sizeof(buf), "%*d", len, num);
    oled_show_string(x, y, buf);
}

/* ── 显示 16x16 中文字 (字库索引) ────────────────────────────── */
void oled_show_chinese(uint8_t x, uint8_t y, uint8_t idx)
{
    uint8_t row, col;

    if (idx >= CN_COUNT) return;
    if (x > 112 || y > 6) return;   /* 越界保护: 需 16x16 空间 */

    /*
     * 逐行式字库: 16行, 每行2字节 (左8列 + 右8列)
     * 阴码: 0=亮(笔画) → 位为0时点亮
     * 水平位序: MSB(bit7)=最左列, 顺向
     * 垂直位序: bit7=顶部 → row 0 映射到 bit 7
     */
    for (row = 0; row < 16; row++)
    {
        uint8_t page = y + row / 8;              /* 页 = 行/8 */
        uint8_t bit  = 7 - (row % 8);            /* row 0 → bit 7 (顶部) */
        uint8_t left  = cn_font[idx][row * 2];      /* 左 8 列 */
        uint8_t right = cn_font[idx][row * 2 + 1];  /* 右 8 列 */

        for (col = 0; col < 8; col++)
        {
            if (!(left & (0x80 >> col)))
                oled_buffer[x + col][page] |= (1 << bit);
            if (!(right & (0x80 >> col)))
                oled_buffer[x + 8 + col][page] |= (1 << bit);
        }
    }
}

/* ── 测试Demo: 全屏点亮 → 清屏 → 显示信息 ──────────────────── */
void oled_test_demo(void)
{
    uint8_t x, y;

    /* 1. 全屏点亮 1 秒 */
    for (x = 0; x < 128; x++)
        for (y = 0; y < 64; y++)
            oled_draw_point(x, y, 1);
    oled_show();
    HAL_Delay(500);

    /* 2. 清屏 */
    oled_clear();
    oled_show();
    HAL_Delay(200);

    /* 3. 显示标题 */
    oled_show_string(0,  0, "STM32F103RCT6");
    oled_show_string(0,  1, "OLED SSD1306");
    oled_show_string(0,  2, "I2C Test OK!");
    oled_show_string(0,  4, "Smart Home");
    oled_show_string(0,  5, "Board Test");
    oled_show_string(0,  7, "KEY0 to continue");
    oled_show();

    /* 4. 串口同步输出 */
    printf("\r\n[OLED] Init OK, test pattern displayed.\r\n");
    printf("[OLED] 128x64 @ I2C 0x3C, 400kHz\r\n");
}
